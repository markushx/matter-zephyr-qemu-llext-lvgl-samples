## CMakeLists.txt
```
cmake_minimum_required(VERSION 3.20.0)

if(NOT CHIP_ROOT)
    if(DEFINED ENV{CHIP_ROOT})
        set(CHIP_ROOT $ENV{CHIP_ROOT})
    else()
        get_filename_component(CHIP_ROOT ${CMAKE_CURRENT_SOURCE_DIR}/../../connectedhomeip-worktree-zephyr REALPATH)
    endif()
endif()

# CONFIG_CHIP isn't known yet (Kconfig hasn't run) -- chip-module/CMakeLists.txt
# itself gates everything on CONFIG_CHIP, so it's harmless to always add it.
list(APPEND ZEPHYR_EXTRA_MODULES ${CHIP_ROOT}/config/zephyr/chip-module)

find_package(Zephyr HINTS $ENV{ZEPHYR_BASE})
project(matter_zephyr_qemu_llext_dynamic)

get_filename_component(GEN_DIR ${CHIP_ROOT}/zzz_generated/ REALPATH)
include(${CHIP_ROOT}/src/app/chip_data_model.cmake)

target_include_directories(app PRIVATE
    include
    ${GEN_DIR}/app-common
    ${GEN_DIR}/bridge-app
)

target_sources(app PRIVATE
    src/main.cpp
    src/AppTask.cpp
    src/ActionsStub.cpp
    src/ZclCallbacks.cpp
    src/dynamic/DynamicEndpointManager.cpp
    src/dynamic/DynamicExports.c
    src/llext/ExtensionLoaderCluster.cpp
)

chip_configure_data_model(app
    # The bridge data model: root node (EP0), Aggregator (EP1), and a
    # placeholder endpoint (EP2) that only makes ZAP generate the cluster
    # servers bridged devices can use -- DynamicEndpointManager::Init() hides it.
    ZAP_FILE ${CHIP_ROOT}/examples/bridge-app/bridge-common/bridge-app.zap
)
```

## prj.conf
```kconfig
# M1 step 2: bare boot + networking smoke test.
CONFIG_NETWORKING=y
CONFIG_NET_L2_ETHERNET=y
CONFIG_NET_IPV4=y
CONFIG_NET_IPV6=y
CONFIG_NET_DHCPV4=y
CONFIG_NET_IPV6_MLD=y

CONFIG_SHELL=y
CONFIG_NET_SHELL=y

CONFIG_LOG=y

# M1 step 3: CHIP library build (no data model / Server init yet -- just
# prove the chip-module GN build works for qemu_x86).
CONFIG_CHIP=y
CONFIG_CHIP_ETHERNET=y
CONFIG_CHIP_LIB_SHELL=n
CONFIG_STD_CPP17=y
CONFIG_POSIX_API=y
# mbedTLS 4.x (this Zephyr's default) removed the classic headers CHIP's
# direct-mbedtls crypto backend expects (mbedtls/bignum.h etc are gone/moved
# into tf-psa-crypto internals). Use CHIP's PSA-based crypto backend instead.
CONFIG_PSA_CRYPTO=y
CONFIG_MBEDTLS=y
CONFIG_CHIP_CRYPTO_PSA=y
# Every secure session holds two PSA key slots (I2R + R2I AES keys) until it
# is evicted, and chip-tool opens a new CASE session per invocation without
# closing the old one. With Zephyr's default of 16 slots the 8th session
# since boot fails in Sigma1 ("Invalid CASE parameter" on the controller).
# Size for the full session pool (CHIP_CONFIG_MAX_FABRICS * 3 + 2 = 17 here)
# plus operational/ephemeral keys; same value nRF Connect's Matter config uses.
CONFIG_MBEDTLS_PSA_KEY_SLOT_COUNT=64
# SPAKE2+ specifically: mbedTLS 4.x has no PSA_ALG_SPAKE2P_MATTER support
# (upstream mbedtls#9378/#9381, unresolved 2+ years), so PSASpake2p.cpp
# (chip_crypto_spake2p="psa") fails to link. CHIPCryptoPALPSA.cpp already
# contains a complete classic SPAKE2+ implementation against mbedTLS's
# private ecp.h/bignum.h, gated behind this exact Kconfig -- no new source
# file needed, just don't select the (broken) PSA-native pake variant.
CONFIG_CHIP_CRYPTO_SPAKE2P_MBEDTLS=y

# No Thread/BLE/Wi-Fi for this port.
CONFIG_NET_L2_OPENTHREAD=n
CONFIG_OPENTHREAD=n
CONFIG_BT=n
CONFIG_CHIP_WIFI=n

# M1 step 4: data model + commissioning. The data model here is bridge-app's
# (root node + Aggregator), see CMakeLists.txt.
CONFIG_CHIP_PROJECT_CONFIG="include/CHIPProjectConfig.h"
CONFIG_CHIP_ENABLE_PAIRING_AUTOSTART=y

# Persistent storage: a virtio-blk disk (see boards/qemu_x86.overlay),
# formatted FAT and auto-mounted via devicetree fstab, with CHIP's Settings
# using CONFIG_SETTINGS_FILE instead of the ephemeral RAM-backed flash
# simulator -- commissioning survives QEMU restarts.
CONFIG_FLASH=y
CONFIG_FLASH_MAP=y
CONFIG_NVS=y
CONFIG_DISK_ACCESS=y
CONFIG_DISK_DRIVERS=y
CONFIG_DISK_DRIVER_VIRTIO_BLK=y
CONFIG_FILE_SYSTEM=y
CONFIG_FILE_SYSTEM_MKFS=y
CONFIG_FAT_FILESYSTEM_ELM=y
CONFIG_FS_FATFS_FSTAB_AUTOMOUNT=y
CONFIG_SETTINGS=y
CONFIG_SETTINGS_NVS=n
CONFIG_SETTINGS_FILE=y
CONFIG_SETTINGS_FILE_PATH="/SD:/settings/run"

# Entropy: prototype only, not a real HWRNG.
CONFIG_TEST_RANDOM_GENERATOR=y

# Memory. We have 32MB of board RAM to spare; be generous with both.
CONFIG_CHIP_MALLOC_SYS_HEAP=y
CONFIG_CHIP_MALLOC_SYS_HEAP_SIZE=131072
CONFIG_MAIN_STACK_SIZE=32768
# Zephyr's OWN separate malloc arena (lib/libc/common/.../malloc.c) crashed in
# its own SYS_INIT hook (malloc_prepare) -- and it's dead weight for us anyway,
# since CHIP_MALLOC_SYS_HEAP_OVERRIDE wraps malloc/calloc/realloc/free to route
# through its own heap instead. Disabled outright; see plan-detailed.md.
CONFIG_COMMON_LIBC_MALLOC=n

# Logging: default 1KB deferred-log ring buffer overflows constantly under
# CHIP's verbose debug-level logging (commissioning especially), silently
# dropping messages. We have RAM to spare.
CONFIG_LOG_BUFFER_SIZE=16384

# LLEXT (Linkable Loadable Extensions): lets the device load and run a small
# binary extension at runtime via the ExtensionLoaderCluster (EP1, manufacturer
# cluster 0xFFF1FC01) -- see plan/plan-detailed.md Milestone 3. In this sample
# the extensions add Matter endpoints (extensions/onoff_light, temp_sensor,
# counter); scripts/send-llext.py loads one. Up to four can be loaded at once.
#
# CONFIG_LLEXT_IMPORT_ALL_GLOBALS covers the extension -> app direction only
# (the app can find any global the extension defines). The other direction
# is explicit: the API extensions may call is include/
# matter_dynamic_extension.h, exported in src/dynamic/DynamicExports.c.
#
# NOTE: CONFIG_LLEXT_SHELL was tried for the Phase 0 smoke test (`llext
# load_hex`) but subsys/llext/shell.c calls plain libc aligned_alloc()/free(),
# which aren't covered by our --wrap=malloc interception and need picolibc's
# real sbrk()-based heap -- which needs __heap_start/__heap_end, which aren't
# defined because CONFIG_COMMON_LIBC_MALLOC=n (see above; disabled for an
# unrelated M1 crash). Rather than re-litigate that, HandleLoadDone() calls
# llext_load() directly instead of via the shell.
CONFIG_LLEXT=y
CONFIG_LLEXT_STORAGE_WRITABLE=y
# Each loaded extension takes four or five page-aligned (4 KiB) regions from
# this heap, plus what the alignment wastes; 128 KiB was not enough for the
# fourth extension.
CONFIG_LLEXT_HEAP_SIZE=512
CONFIG_LLEXT_IMPORT_ALL_GLOBALS=y
```

## src/main.cpp
```c
#include "AppTask.h"

#include <lib/support/logging/CHIPLogging.h>

int main()
{
    CHIP_ERROR err = AppTask::Instance().Init();
    if (err != CHIP_NO_ERROR)
    {
        ChipLogError(NotSpecified, "AppTask::Init failed: %" CHIP_ERROR_FORMAT, err.Format());
        return -1;
    }

    AppTask::Instance().StartApp();
    return 0;
}
```

## include/CHIPProjectConfig.h
```c
#pragma once

// Use a default pairing code if one hasn't been provisioned in flash.
#define CHIP_DEVICE_CONFIG_USE_TEST_SETUP_PIN_CODE 20202021
#define CHIP_DEVICE_CONFIG_USE_TEST_SETUP_DISCRIMINATOR 0xF00

// How many endpoints extensions can add in total (Ember "dynamic endpoints",
// see src/dynamic/DynamicEndpointManager.cpp).
#define CHIP_DEVICE_CONFIG_DYNAMIC_ENDPOINT_COUNT 8

// Exchange Manager / Secure Channel / interaction-model (DMG) logging is
// extremely chatty at Progress/Detail (every message send/receive, every
// attribute read) and drowns out ZCL's own logging in the 16KB ring buffer.
// Keep Error-level diagnostics from all three; drop Progress/Detail. ZCL
// (and everything else) is left at the global log filter.
#define CHIP_CONFIG_LOG_MODULE_ExchangeManager_PROGRESS 0
#define CHIP_CONFIG_LOG_MODULE_ExchangeManager_DETAIL 0
#define CHIP_CONFIG_LOG_MODULE_SecureChannel_PROGRESS 0
#define CHIP_CONFIG_LOG_MODULE_SecureChannel_DETAIL 0
#define CHIP_CONFIG_LOG_MODULE_DataManagement_PROGRESS 0
#define CHIP_CONFIG_LOG_MODULE_DataManagement_DETAIL 0
```

## src/ActionsStub.cpp
```c
// The Aggregator endpoint of the bridge-app data model carries the Actions
// cluster, which needs a delegate. This bridge defines no actions (rooms,
// scenes, ...) -- examples/bridge-app/linux/bridged-actions-stub.cpp shows
// what a real one looks like -- so the delegate reports empty lists and
// knows no action IDs.

#include <app/clusters/actions-server/actions-server.h>
#include <app/util/attribute-storage.h>
#include <lib/support/CodeUtils.h>

#include <memory>

using namespace chip;
using namespace chip::app::Clusters;
using namespace chip::app::Clusters::Actions;
using chip::Protocols::InteractionModel::Status;

namespace {

class NoActionsDelegate : public Actions::Delegate
{
public:
    CHIP_ERROR ReadActionAtIndex(uint16_t index, ActionStructStorage & action) override
    {
        return CHIP_ERROR_PROVIDER_LIST_EXHAUSTED;
    }
    CHIP_ERROR ReadEndpointListAtIndex(uint16_t index, EndpointListStorage & epList) override
    {
        return CHIP_ERROR_PROVIDER_LIST_EXHAUSTED;
    }
    bool HaveActionWithId(uint16_t actionId, uint16_t & actionIndex) override { return false; }

    Status HandleInstantAction(uint16_t actionId, Optional<uint32_t> invokeId) override { return Status::NotFound; }
    Status HandleInstantActionWithTransition(uint16_t actionId, uint16_t transitionTime, Optional<uint32_t> invokeId) override
    {
        return Status::NotFound;
    }
    Status HandleStartAction(uint16_t actionId, Optional<uint32_t> invokeId) override { return Status::NotFound; }
    Status HandleStartActionWithDuration(uint16_t actionId, uint32_t duration, Optional<uint32_t> invokeId) override
    {
        return Status::NotFound;
    }
    Status HandleStopAction(uint16_t actionId, Optional<uint32_t> invokeId) override { return Status::NotFound; }
    Status HandlePauseAction(uint16_t actionId, Optional<uint32_t> invokeId) override { return Status::NotFound; }
    Status HandlePauseActionWithDuration(uint16_t actionId, uint32_t duration, Optional<uint32_t> invokeId) override
    {
        return Status::NotFound;
    }
    Status HandleResumeAction(uint16_t actionId, Optional<uint32_t> invokeId) override { return Status::NotFound; }
    Status HandleEnableAction(uint16_t actionId, Optional<uint32_t> invokeId) override { return Status::NotFound; }
    Status HandleEnableActionWithDuration(uint16_t actionId, uint32_t duration, Optional<uint32_t> invokeId) override
    {
        return Status::NotFound;
    }
    Status HandleDisableAction(uint16_t actionId, Optional<uint32_t> invokeId) override { return Status::NotFound; }
    Status HandleDisableActionWithDuration(uint16_t actionId, uint32_t duration, Optional<uint32_t> invokeId) override
    {
        return Status::NotFound;
    }
};

NoActionsDelegate sDelegate;
std::unique_ptr<Actions::ActionsServer> sActionsServer;

} // namespace

void emberAfActionsClusterInitCallback(EndpointId endpoint)
{
    VerifyOrReturn(emberAfContainsServer(endpoint, Actions::Id) && !sActionsServer);

    sActionsServer = std::make_unique<Actions::ActionsServer>(endpoint, sDelegate);
    LogErrorOnFailure(sActionsServer->Init());
}
```

## src/AppTask.cpp
```c
#include "AppTask.h"
#include "EthernetNetworkCommissioningDriver.h"
#include "dynamic/DynamicEndpointManager.h"
#include "llext/ExtensionLoaderCluster.h"

#include <app/TestEventTriggerDelegate.h>
#include <app/clusters/network-commissioning/network-commissioning.h>
#include <app/server/Server.h>
#include <app/server-cluster/ServerClusterInterfaceRegistry.h>
#include <credentials/examples/DeviceAttestationCredsExample.h>
#include <data-model-providers/codegen/CodegenDataModelProvider.h>
#include <data-model-providers/codegen/Instance.h>
#include <DeviceInfoProviderImpl.h>
#include <lib/support/CHIPMem.h>
#include <lib/support/logging/CHIPLogging.h>
#include <platform/CHIPDeviceLayer.h>
#include <setup_payload/OnboardingCodesUtil.h>

using namespace chip;
using namespace chip::app;
using namespace chip::Credentials;
using namespace chip::DeviceLayer;

namespace {
// Not function-local statics with no dependency on the CHIP/kernel stack being
// up yet -- safe to construct at global static-init time.
DeviceLayer::NetworkCommissioning::QemuEthernetDriver sEthernetDriver;
uint8_t sTestEventTriggerEnableKey[TestEventTriggerDelegate::kEnableKeyLength] = { 0 };
} // namespace

CHIP_ERROR AppTask::Init()
{
    ReturnErrorOnFailure(Platform::MemoryInit());
    ReturnErrorOnFailure(PlatformMgr().InitChipStack());

    SetDeviceAttestationCredentialsProvider(Examples::GetExampleDACProvider());

    // Function-local statics: their constructors call into Server::GetInstance()
    // et al (e.g. NetworkCommissioning::Instance's Context member initializer),
    // which must not run before InitChipStack() above -- as global (namespace-
    // scope) statics they'd construct before main() / the kernel is fully up,
    // corrupting memory (observed as a garbage-EIP crash in the idle thread).
    static CommonCaseDeviceServerInitParams sInitParams;
    static SimpleTestEventTriggerDelegate sTestEventTriggerDelegate;
    static Clusters::NetworkCommissioning::Instance sEthernetCommissioningInstance(0 /* endpoint */, &sEthernetDriver);

    ReturnErrorOnFailure(sInitParams.InitializeStaticResourcesBeforeServerInit());

    // Required by clusters that ship with our data model (e.g. User Label on
    // EP0) -- CreateRegistration() VerifyOrDie()s on this being non-null.
    static DeviceInfoProviderImpl sDeviceInfoProvider;
    sDeviceInfoProvider.SetStorageDelegate(sInitParams.persistentStorageDelegate);
    SetDeviceInfoProvider(&sDeviceInfoProvider);

    ReturnErrorOnFailure(sTestEventTriggerDelegate.Init(ByteSpan(sTestEventTriggerEnableKey)));
    sInitParams.testEventTriggerDelegate = &sTestEventTriggerDelegate;
    sInitParams.dataModelProvider        = CodegenDataModelProviderInstance(sInitParams.persistentStorageDelegate);

    ReturnErrorOnFailure(sEthernetCommissioningInstance.Init());

    ReturnErrorOnFailure(Server::GetInstance().Init(sInitParams));

    DynamicEndpointManager::Init();

    ConfigurationMgr().LogDeviceConfig();
    PrintOnboardingCodes(RendezvousInformationFlags(RendezvousInformationFlag::kOnNetwork));

    {
        static RegisteredServerCluster<ExtensionLoaderCluster> sExtensionLoaderCluster;
        ReturnErrorOnFailure(CodegenDataModelProvider::Instance().Registry().Register(sExtensionLoaderCluster.Registration()));
    }

    return CHIP_NO_ERROR;
}

void AppTask::StartApp()
{
    PlatformMgr().RunEventLoop();
}
```

## src/ZclCallbacks.cpp
```c
#include <app/ConcreteAttributePath.h>
#include <lib/support/logging/CHIPLogging.h>

// This app has no device behaviour of its own: the only attributes that live
// in the app's own attribute store belong to the root node and the
// Aggregator. Everything on the dynamic endpoints uses external storage and
// goes to the extension that provides it (src/dynamic/), not through here.
void MatterPostAttributeChangeCallback(const chip::app::ConcreteAttributePath & attributePath, uint8_t type, uint16_t size,
                                       uint8_t * value)
{
    ChipLogDetail(NotSpecified, "Attribute changed: endpoint %u cluster 0x%08lx attribute 0x%08lx", attributePath.mEndpointId,
                  static_cast<unsigned long>(attributePath.mClusterId), static_cast<unsigned long>(attributePath.mAttributeId));
}
```
