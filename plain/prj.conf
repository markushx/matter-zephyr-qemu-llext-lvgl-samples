## CMakeLists.txt
```
cmake_minimum_required(VERSION 3.20.0)

if(NOT CHIP_ROOT)
    if(DEFINED ENV{CHIP_ROOT})
        set(CHIP_ROOT $ENV{CHIP_ROOT})
    else()
        get_filename_component(CHIP_ROOT ${CMAKE_CURRENT_SOURCE_DIR}/../../connectedhomeip-worktree-zephyr REALPATH)
    endif()
endif()

# CONFIG_CHIP isn't known yet (Kconfig hasn't run) -- chip-module/CMakeLists.txt
# itself gates everything on CONFIG_CHIP, so it's harmless to always add it.
list(APPEND ZEPHYR_EXTRA_MODULES ${CHIP_ROOT}/config/zephyr/chip-module)

find_package(Zephyr HINTS $ENV{ZEPHYR_BASE})
project(matter_zephyr_qemu_plain)

get_filename_component(GEN_DIR ${CHIP_ROOT}/zzz_generated/ REALPATH)
include(${CHIP_ROOT}/src/app/chip_data_model.cmake)

target_include_directories(app PRIVATE
    include
    ${GEN_DIR}/app-common
    ${GEN_DIR}/lighting-app
)

target_sources(app PRIVATE
    src/main.cpp
    src/AppTask.cpp
    src/LightingManager.cpp
    src/ZclCallbacks.cpp
)

chip_configure_data_model(app
    ZAP_FILE ${CHIP_ROOT}/examples/lighting-app/lighting-common/lighting-app.zap
)
```

## prj.conf
```kconfig
# Networking
CONFIG_NETWORKING=y
CONFIG_NET_L2_ETHERNET=y
CONFIG_NET_IPV4=y
CONFIG_NET_IPV6=y
CONFIG_NET_DHCPV4=y
CONFIG_NET_IPV6_MLD=y

CONFIG_SHELL=y
CONFIG_NET_SHELL=y

CONFIG_LOG=y

# CHIP library
CONFIG_CHIP=y
CONFIG_CHIP_ETHERNET=y
CONFIG_CHIP_LIB_SHELL=n
CONFIG_STD_CPP17=y
CONFIG_POSIX_API=y
# mbedTLS 4.x (this Zephyr's default) removed the classic headers CHIP's
# direct-mbedtls crypto backend expects (mbedtls/bignum.h etc are gone/moved
# into tf-psa-crypto internals). Use CHIP's PSA-based crypto backend instead.
CONFIG_PSA_CRYPTO=y
CONFIG_MBEDTLS=y
CONFIG_CHIP_CRYPTO_PSA=y
# SPAKE2+ specifically: mbedTLS 4.x has no PSA_ALG_SPAKE2P_MATTER support
# (upstream mbedtls#9378/#9381, unresolved 2+ years), so PSASpake2p.cpp
# (chip_crypto_spake2p="psa") fails to link. CHIPCryptoPALPSA.cpp already
# contains a complete classic SPAKE2+ implementation against mbedTLS's
# private ecp.h/bignum.h, gated behind this exact Kconfig -- no new source
# file needed, just don't select the (broken) PSA-native pake variant.
CONFIG_CHIP_CRYPTO_SPAKE2P_MBEDTLS=y

# No Thread/BLE/Wi-Fi for this port.
CONFIG_NET_L2_OPENTHREAD=n
CONFIG_OPENTHREAD=n
CONFIG_BT=n
CONFIG_CHIP_WIFI=n

# Data model + commissioning + on/off/level.
CONFIG_CHIP_PROJECT_CONFIG="include/CHIPProjectConfig.h"
CONFIG_CHIP_ENABLE_PAIRING_AUTOSTART=y

# Persistent storage: a virtio-blk disk (see boards/qemu_x86.overlay),
# formatted FAT and auto-mounted via devicetree fstab, with CHIP's Settings
# using CONFIG_SETTINGS_FILE instead of the ephemeral RAM-backed flash
# simulator -- commissioning survives QEMU restarts.
CONFIG_FLASH=y
CONFIG_FLASH_MAP=y
CONFIG_NVS=y
CONFIG_DISK_ACCESS=y
CONFIG_DISK_DRIVERS=y
CONFIG_DISK_DRIVER_VIRTIO_BLK=y
CONFIG_FILE_SYSTEM=y
CONFIG_FILE_SYSTEM_MKFS=y
CONFIG_FAT_FILESYSTEM_ELM=y
CONFIG_FS_FATFS_FSTAB_AUTOMOUNT=y
CONFIG_SETTINGS=y
CONFIG_SETTINGS_NVS=n
CONFIG_SETTINGS_FILE=y
CONFIG_SETTINGS_FILE_PATH="/SD:/settings/run"

# Entropy: prototype only, not a real HWRNG.
CONFIG_TEST_RANDOM_GENERATOR=y

# Memory. We have 32MB of board RAM to spare; be generous with both.
CONFIG_CHIP_MALLOC_SYS_HEAP=y
CONFIG_CHIP_MALLOC_SYS_HEAP_SIZE=131072
CONFIG_MAIN_STACK_SIZE=32768
# Zephyr's OWN separate malloc arena (lib/libc/common/.../malloc.c) crashed in
# its own SYS_INIT hook (malloc_prepare) -- and it's dead weight for us anyway,
# since CHIP_MALLOC_SYS_HEAP_OVERRIDE wraps malloc/calloc/realloc/free to route
# through its own heap instead. Disabled outright; see plan-detailed.md.
CONFIG_COMMON_LIBC_MALLOC=n

# Logging: default 1KB deferred-log ring buffer overflows constantly under
# CHIP's verbose debug-level logging (commissioning especially), silently
# dropping messages. We have RAM to spare.
CONFIG_LOG_BUFFER_SIZE=16384
```

## src/AppTask.cpp
```c
#include "AppTask.h"
#include "EthernetNetworkCommissioningDriver.h"
#include "LightingManager.h"

#include <app/TestEventTriggerDelegate.h>
#include <app/clusters/network-commissioning/network-commissioning.h>
#include <app/server/Server.h>
#include <credentials/examples/DeviceAttestationCredsExample.h>
#include <data-model-providers/codegen/Instance.h>
#include <DeviceInfoProviderImpl.h>
#include <lib/support/CHIPMem.h>
#include <lib/support/logging/CHIPLogging.h>
#include <platform/CHIPDeviceLayer.h>
#include <setup_payload/OnboardingCodesUtil.h>

using namespace chip;
using namespace chip::app;
using namespace chip::Credentials;
using namespace chip::DeviceLayer;

namespace {
// Not function-local statics with no dependency on the CHIP/kernel stack being
// up yet -- safe to construct at global static-init time.
DeviceLayer::NetworkCommissioning::QemuEthernetDriver sEthernetDriver;
uint8_t sTestEventTriggerEnableKey[TestEventTriggerDelegate::kEnableKeyLength] = { 0 };
} // namespace

CHIP_ERROR AppTask::Init()
{
    ReturnErrorOnFailure(Platform::MemoryInit());
    ReturnErrorOnFailure(PlatformMgr().InitChipStack());

    SetDeviceAttestationCredentialsProvider(Examples::GetExampleDACProvider());

    // Function-local statics: their constructors call into Server::GetInstance()
    // et al (e.g. NetworkCommissioning::Instance's Context member initializer),
    // which must not run before InitChipStack() above -- as global (namespace-
    // scope) statics they'd construct before main() / the kernel is fully up,
    // corrupting memory (observed as a garbage-EIP crash in the idle thread).
    static CommonCaseDeviceServerInitParams sInitParams;
    static SimpleTestEventTriggerDelegate sTestEventTriggerDelegate;
    static Clusters::NetworkCommissioning::Instance sEthernetCommissioningInstance(0 /* endpoint */, &sEthernetDriver);

    ReturnErrorOnFailure(sInitParams.InitializeStaticResourcesBeforeServerInit());

    // Required by clusters that ship with our data model (e.g. User Label on
    // EP0) -- CreateRegistration() VerifyOrDie()s on this being non-null.
    static DeviceInfoProviderImpl sDeviceInfoProvider;
    sDeviceInfoProvider.SetStorageDelegate(sInitParams.persistentStorageDelegate);
    SetDeviceInfoProvider(&sDeviceInfoProvider);

    ReturnErrorOnFailure(sTestEventTriggerDelegate.Init(ByteSpan(sTestEventTriggerEnableKey)));
    sInitParams.testEventTriggerDelegate = &sTestEventTriggerDelegate;
    sInitParams.dataModelProvider        = CodegenDataModelProviderInstance(sInitParams.persistentStorageDelegate);

    ReturnErrorOnFailure(sEthernetCommissioningInstance.Init());

    ReturnErrorOnFailure(Server::GetInstance().Init(sInitParams));

    LightingManager::GetInstance().Init();

    ConfigurationMgr().LogDeviceConfig();
    PrintOnboardingCodes(RendezvousInformationFlags(RendezvousInformationFlag::kOnNetwork));

    return CHIP_NO_ERROR;
}

void AppTask::StartApp()
{
    PlatformMgr().RunEventLoop();
}
```

## src/LightingManager.h
```c
#pragma once

#include <cstdint>

class LightingManager
{
public:
    static LightingManager & GetInstance()
    {
        static LightingManager instance;
        return instance;
    }

    void Set(bool onOff);
    void SetLevel(uint8_t level);
    bool IsTurnedOn() const { return mOnOff; }
    uint8_t GetLevel() const { return mLevel; }

private:
    bool mOnOff     = false;
    uint8_t mLevel = 254;
};
```
