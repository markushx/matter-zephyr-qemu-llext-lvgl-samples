## CMakeLists.txt
```
# ztest suite for ExtensionSignature, with CHIP's real crypto. The sample itself only
# builds for the DK, with NCS, so this uses the configuration of the 2_llext/ sample,
# which has the same PSA crypto backend, and only ExtensionSignature.cpp from this one.
# Runs under plain QEMU without sudo:
#   scripts/run-llext-ztest.sh 6_nrf52840_signed/tests/signature
cmake_minimum_required(VERSION 3.20.0)

if(NOT CHIP_ROOT)
    if(DEFINED ENV{CHIP_ROOT})
        set(CHIP_ROOT $ENV{CHIP_ROOT})
    else()
        get_filename_component(CHIP_ROOT ${CMAKE_CURRENT_SOURCE_DIR}/../../../../connectedhomeip-worktree-zephyr REALPATH)
    endif()
endif()

list(APPEND ZEPHYR_EXTRA_MODULES ${CHIP_ROOT}/config/zephyr/chip-module)

get_filename_component(SAMPLE_DIR ${CMAKE_CURRENT_SOURCE_DIR}/../.. REALPATH)
get_filename_component(CONFIG_DIR ${SAMPLE_DIR}/../2_llext REALPATH)
set(CONF_FILE
    ${CONFIG_DIR}/prj.conf
    ${CONFIG_DIR}/boards/qemu_x86.conf
    ${CMAKE_CURRENT_SOURCE_DIR}/prj.conf
)
set(DTC_OVERLAY_FILE ${CONFIG_DIR}/boards/qemu_x86.overlay)

find_package(Zephyr HINTS $ENV{ZEPHYR_BASE})
project(matter_nrf52840_signed_test)

target_include_directories(app PRIVATE
    ${CONFIG_DIR}/include
    ${SAMPLE_DIR}/src
)

target_sources(app PRIVATE
    src/main.cpp
    ${SAMPLE_DIR}/src/llext/ExtensionSignature.cpp
)
```

## prj.conf
```kconfig
# Applied on top of the 2_llext/ sample's own prj.conf (see CMakeLists.txt).
CONFIG_ZTEST=y
CONFIG_ZTEST_STACK_SIZE=16384

# Resolved against this directory, not the 2_llext/ sample's: reuse the sample's.
CONFIG_CHIP_PROJECT_CONFIG="../../../2_llext/include/CHIPProjectConfig.h"
```

## src/main.cpp
```c
/*
 * ztest suite for ExtensionSignature, the check that decides whether an extension
 * may run on the 6_nrf52840_signed sample. Uses images from imgtool, through
 * scripts/sign-llext.py (see generate_test_images.py), and CHIP's real crypto,
 * and changes them the way someone without the signing key could.
 */

#include "llext/ExtensionSignature.h"
#include "test_images.h"

#include <psa/crypto.h>
#include <zephyr/sys/byteorder.h>
#include <zephyr/ztest.h>

#include <cstring>
#include <vector>

using ExtensionSignature::Elf;
using ExtensionSignature::Result;
using Image = std::vector<uint8_t>;

namespace {

constexpr size_t kHeaderSize          = 32;
constexpr size_t kOffsetHeaderSize    = 8;
constexpr size_t kOffsetProtectedSize = 10;
constexpr size_t kOffsetImageSize     = 12;
constexpr size_t kOffsetFlags         = 16;
constexpr uint16_t kTlvFirmwareId     = 0xa0;
constexpr uint16_t kTlvEcdsaSig       = 0x22;

template <size_t N>
Image Copy(const uint8_t (&array)[N])
{
    return Image(array, array + N);
}

Result Check(const Image & image, const chip::Crypto::P256PublicKey & key, uint32_t firmwareId = kFirmwareId)
{
    Elf elf;
    return ExtensionSignature::Verify(image.data(), image.size(), firmwareId, key, elf);
}

Result Check(const Image & image)
{
    return Check(image, chip::Crypto::P256PublicKey(kSigningKey));
}

size_t SignedSize(const Image & image)
{
    return kHeaderSize + sys_get_le32(&image[kOffsetImageSize]) + sys_get_le16(&image[kOffsetProtectedSize]);
}

// Where the value of a TLV in the unprotected area is.
size_t FindUnprotected(const Image & image, uint16_t type)
{
    size_t offset = SignedSize(image) + 4;
    while (offset < image.size())
    {
        if (sys_get_le16(&image[offset]) == type)
        {
            return offset + 4;
        }
        offset += 4 + sys_get_le16(&image[offset + 2]);
    }
    zassert_unreachable("no TLV of type 0x%x", type);
    return 0;
}

} // namespace

ZTEST(extension_signature, test_valid_image)
{
    const Image image = Copy(kSignedImage);
    const chip::Crypto::P256PublicKey key(kSigningKey);

    Elf elf;
    zassert_equal(ExtensionSignature::Verify(image.data(), image.size(), kFirmwareId, key, elf), Result::kValid);
    zassert_equal(elf.size, sizeof(kPayload));
    zassert_mem_equal(image.data() + elf.offset, kPayload, sizeof(kPayload));
    // llext runs it in place.
    zassert_equal(elf.offset % 8, 0);
}

ZTEST(extension_signature, test_unsigned_elf)
{
    zassert_equal(Check(Copy(kPayload)), Result::kMalformed);
}

ZTEST(extension_signature, test_other_key)
{
    zassert_equal(Check(Copy(kSignedImage), chip::Crypto::P256PublicKey(kOtherKey)), Result::kBadSignature);
}

ZTEST(extension_signature, test_other_firmware)
{
    zassert_equal(Check(Copy(kSignedImage), chip::Crypto::P256PublicKey(kSigningKey), kFirmwareId + 1), Result::kWrongFirmware);
}

ZTEST(extension_signature, test_no_firmware_id)
{
    zassert_equal(Check(Copy(kNoFirmwareIdImage)), Result::kWrongFirmware);
}

// Anyone can add to the unprotected TLVs, so that mustn't work for the firmware ID.
ZTEST(extension_signature, test_firmware_id_in_unprotected_tlvs)
{
    Image image = Copy(kNoFirmwareIdImage);
    uint8_t tlv[8];
    sys_put_le16(kTlvFirmwareId, &tlv[0]);
    sys_put_le16(sizeof(uint32_t), &tlv[2]);
    sys_put_le32(kFirmwareId, &tlv[4]);
    image.insert(image.end(), tlv, tlv + sizeof(tlv));

    const size_t total = SignedSize(image) + 2;
    sys_put_le16(sys_get_le16(&image[total]) + sizeof(tlv), &image[total]);

    zassert_equal(Check(image), Result::kWrongFirmware);
}

// Header, ELF and firmware ID alike, whichever way it fails.
ZTEST(extension_signature, test_every_signed_byte_counts)
{
    const Image original = Copy(kSignedImage);
    const size_t signedSize = SignedSize(original);
    for (size_t i = 0; i < signedSize; i++)
    {
        Image image = original;
        image[i] ^= 0x01;
        zassert_not_equal(Check(image), Result::kValid, "changing byte %u went unnoticed", static_cast<unsigned>(i));
    }
}

ZTEST(extension_signature, test_changed_signature)
{
    Image image = Copy(kSignedImage);
    image.back() ^= 0x01;
    zassert_equal(Check(image), Result::kBadSignature);

    image = Copy(kSignedImage);
    image[FindUnprotected(image, kTlvEcdsaSig)] ^= 0x01; // No DER sequence any more.
    zassert_equal(Check(image), Result::kBadSignature);
}

ZTEST(extension_signature, test_no_signature)
{
    Image image = Copy(kSignedImage);
    sys_put_le16(0x7fff, &image[FindUnprotected(image, kTlvEcdsaSig) - 4]);
    zassert_equal(Check(image), Result::kMalformed);
}

ZTEST(extension_signature, test_truncated)
{
    const Image original = Copy(kSignedImage);
    for (size_t size = 0; size < original.size(); size++)
    {
        const Image image(original.begin(), original.begin() + size);
        zassert_equal(Check(image), Result::kMalformed, "accepted the first %u bytes", static_cast<unsigned>(size));
    }
}

ZTEST(extension_signature, test_trailing_bytes)
{
    Image image = Copy(kSignedImage);
    image.push_back(0xff);
    zassert_equal(Check(image), Result::kMalformed);
}

ZTEST(extension_signature, test_sizes_outside_the_image)
{
    Image image = Copy(kSignedImage);
    sys_put_le32(0xffffffff, &image[kOffsetImageSize]);
    zassert_equal(Check(image), Result::kMalformed);

    image = Copy(kSignedImage);
    sys_put_le32(0, &image[kOffsetImageSize]);
    zassert_equal(Check(image), Result::kMalformed);

    image = Copy(kSignedImage);
    sys_put_le16(0xffff, &image[kOffsetProtectedSize]);
    zassert_equal(Check(image), Result::kMalformed);

    image = Copy(kSignedImage);
    sys_put_le16(0xffff, &image[SignedSize(image) + 2]);
    zassert_equal(Check(image), Result::kMalformed);
}

ZTEST(extension_signature, test_unsupported_header)
{
    Image image = Copy(kSignedImage);
    sys_put_le16(kHeaderSize * 2, &image[kOffsetHeaderSize]);
    zassert_equal(Check(image), Result::kMalformed);

    image = Copy(kSignedImage);
    image[kOffsetFlags] = 0x04;
    zassert_equal(Check(image), Result::kMalformed);
}

static void * Setup(void)
{
    zassert_equal(psa_crypto_init(), PSA_SUCCESS);
    return nullptr;
}

ZTEST_SUITE(extension_signature, nullptr, Setup, nullptr, nullptr, nullptr);
```

## src/test_images.h
```c
/* Generated by ../generate_test_images.py. */
#pragma once

#include <cstdint>

inline constexpr uint32_t kFirmwareId = 0x12345678;

inline constexpr uint8_t kSigningKey[65] = {
    0x04, 0xd5, 0xb9, 0x7a, 0x64, 0xe3, 0x34, 0xab, 0xfa, 0x5b, 0x4a, 0xca,
    0xf2, 0xad, 0x8f, 0xb3, 0xd5, 0x41, 0x48, 0xc5, 0x34, 0xe4, 0xcd, 0x18,
    0xc1, 0x23, 0x4b, 0x9a, 0x15, 0x73, 0x7a, 0x34, 0xc0, 0x6f, 0x01, 0x7c,
    0x3b, 0x82, 0x32, 0xed, 0x3a, 0x64, 0xcf, 0x59, 0xdf, 0x9c, 0x8d, 0x61,
    0x07, 0xce, 0xeb, 0xc6, 0x3b, 0x5f, 0x95, 0x74, 0x76, 0x69, 0x08, 0xbc,
    0xbb, 0x19, 0x62, 0x58, 0x6a
};

inline constexpr uint8_t kOtherKey[65] = {
    0x04, 0xe6, 0x87, 0x7d, 0x17, 0x7f, 0x7b, 0x5b, 0xe3, 0x69, 0xa6, 0xe2,
    0xf3, 0xc9, 0xdf, 0x0b, 0xb3, 0xd1, 0xbc, 0x57, 0x93, 0x51, 0x90, 0xe4,
    0x11, 0x15, 0xcc, 0x87, 0x01, 0x75, 0x38, 0x25, 0xc2, 0x6d, 0x4d, 0xbe,
    0xe3, 0x31, 0x1b, 0x59, 0xfa, 0xbe, 0x27, 0x5f, 0x3c, 0xf0, 0xda, 0x84,
    0x45, 0x0f, 0xb2, 0x39, 0x3b, 0x44, 0x6b, 0x24, 0xd7, 0x6e, 0xa4, 0x78,
    0xc3, 0xeb, 0x93, 0x1c, 0x83
};

inline constexpr uint8_t kPayload[128] = {
    0x7f, 0x45, 0x4c, 0x46, 0x00, 0x01, 0x02, 0x03, 0x04, 0x05, 0x06, 0x07,
    0x08, 0x09, 0x0a, 0x0b, 0x0c, 0x0d, 0x0e, 0x0f, 0x10, 0x11, 0x12, 0x13,
    0x14, 0x15, 0x16, 0x17, 0x18, 0x19, 0x1a, 0x1b, 0x1c, 0x1d, 0x1e, 0x1f,
    0x20, 0x21, 0x22, 0x23, 0x24, 0x25, 0x26, 0x27, 0x28, 0x29, 0x2a, 0x2b,
    0x2c, 0x2d, 0x2e, 0x2f, 0x30, 0x31, 0x32, 0x33, 0x34, 0x35, 0x36, 0x37,
    0x38, 0x39, 0x3a, 0x3b, 0x3c, 0x3d, 0x3e, 0x3f, 0x40, 0x41, 0x42, 0x43,
    0x44, 0x45, 0x46, 0x47, 0x48, 0x49, 0x4a, 0x4b, 0x4c, 0x4d, 0x4e, 0x4f,
    0x50, 0x51, 0x52, 0x53, 0x54, 0x55, 0x56, 0x57, 0x58, 0x59, 0x5a, 0x5b,
    0x5c, 0x5d, 0x5e, 0x5f, 0x60, 0x61, 0x62, 0x63, 0x64, 0x65, 0x66, 0x67,
    0x68, 0x69, 0x6a, 0x6b, 0x6c, 0x6d, 0x6e, 0x6f, 0x70, 0x71, 0x72, 0x73,
    0x74, 0x75, 0x76, 0x77, 0x78, 0x79, 0x7a, 0x7b
};

inline constexpr uint8_t kSignedImage[324] = {
    0x3d, 0xb8, 0xf3, 0x96, 0x00, 0x00, 0x00, 0x00, 0x20, 0x00, 0x0c, 0x00,
    0x80, 0x00, 0x00, 0x00, 0x00, 0x00, 0x00, 0x00, 0x00, 0x00, 0x00, 0x00,
    0x00, 0x00, 0x00, 0x00, 0x00, 0x00, 0x00, 0x00, 0x7f, 0x45, 0x4c, 0x46,
    0x00, 0x01, 0x02, 0x03, 0x04, 0x05, 0x06, 0x07, 0x08, 0x09, 0x0a, 0x0b,
    0x0c, 0x0d, 0x0e, 0x0f, 0x10, 0x11, 0x12, 0x13, 0x14, 0x15, 0x16, 0x17,
    0x18, 0x19, 0x1a, 0x1b, 0x1c, 0x1d, 0x1e, 0x1f, 0x20, 0x21, 0x22, 0x23,
    0x24, 0x25, 0x26, 0x27, 0x28, 0x29, 0x2a, 0x2b, 0x2c, 0x2d, 0x2e, 0x2f,
    0x30, 0x31, 0x32, 0x33, 0x34, 0x35, 0x36, 0x37, 0x38, 0x39, 0x3a, 0x3b,
    0x3c, 0x3d, 0x3e, 0x3f, 0x40, 0x41, 0x42, 0x43, 0x44, 0x45, 0x46, 0x47,
    0x48, 0x49, 0x4a, 0x4b, 0x4c, 0x4d, 0x4e, 0x4f, 0x50, 0x51, 0x52, 0x53,
    0x54, 0x55, 0x56, 0x57, 0x58, 0x59, 0x5a, 0x5b, 0x5c, 0x5d, 0x5e, 0x5f,
    0x60, 0x61, 0x62, 0x63, 0x64, 0x65, 0x66, 0x67, 0x68, 0x69, 0x6a, 0x6b,
    0x6c, 0x6d, 0x6e, 0x6f, 0x70, 0x71, 0x72, 0x73, 0x74, 0x75, 0x76, 0x77,
    0x78, 0x79, 0x7a, 0x7b, 0x08, 0x69, 0x0c, 0x00, 0xa0, 0x00, 0x04, 0x00,
    0x78, 0x56, 0x34, 0x12, 0x07, 0x69, 0x98, 0x00, 0x10, 0x00, 0x20, 0x00,
    0x9d, 0x75, 0x7d, 0x19, 0x5f, 0x7e, 0x01, 0xce, 0x67, 0x38, 0x6c, 0x8a,
    0xa0, 0xd4, 0x9c, 0xb0, 0x5f, 0xb9, 0x60, 0xc2, 0xee, 0x21, 0x56, 0x7b,
    0x16, 0x7e, 0xa3, 0xef, 0x76, 0x26, 0xdf, 0x58, 0x01, 0x00, 0x20, 0x00,
    0x2f, 0x56, 0x6d, 0x57, 0xef, 0x14, 0xed, 0x76, 0xf8, 0xcd, 0xf6, 0x53,
    0x0e, 0xef, 0xd7, 0x82, 0x6b, 0x8a, 0xad, 0xfd, 0x33, 0x51, 0x11, 0x86,
    0xe6, 0x08, 0x2d, 0x36, 0x85, 0x25, 0x2b, 0x21, 0x22, 0x00, 0x48, 0x00,
    0x30, 0x46, 0x02, 0x21, 0x00, 0xc0, 0x72, 0x5a, 0x40, 0x9a, 0x0f, 0xa9,
    0x05, 0x0f, 0x4a, 0x07, 0x57, 0x00, 0x4e, 0x19, 0x0a, 0x7e, 0x5c, 0x12,
    0x39, 0xf7, 0x49, 0xc4, 0x9e, 0x55, 0x53, 0xb0, 0x4b, 0x69, 0xa2, 0xc8,
    0x7d, 0x02, 0x21, 0x00, 0x80, 0x82, 0x2d, 0xa2, 0x40, 0xaa, 0x76, 0x5f,
    0xed, 0x95, 0x38, 0x83, 0x4a, 0xbf, 0xa7, 0x00, 0x6b, 0xf7, 0x9b, 0x46,
    0xdf, 0x66, 0x89, 0xe1, 0x02, 0x71, 0xb6, 0xb4, 0x43, 0x20, 0x65, 0x54
};

inline constexpr uint8_t kNoFirmwareIdImage[311] = {
    0x3d, 0xb8, 0xf3, 0x96, 0x00, 0x00, 0x00, 0x00, 0x20, 0x00, 0x00, 0x00,
    0x80, 0x00, 0x00, 0x00, 0x00, 0x00, 0x00, 0x00, 0x00, 0x00, 0x00, 0x00,
    0x00, 0x00, 0x00, 0x00, 0x00, 0x00, 0x00, 0x00, 0x7f, 0x45, 0x4c, 0x46,
    0x00, 0x01, 0x02, 0x03, 0x04, 0x05, 0x06, 0x07, 0x08, 0x09, 0x0a, 0x0b,
    0x0c, 0x0d, 0x0e, 0x0f, 0x10, 0x11, 0x12, 0x13, 0x14, 0x15, 0x16, 0x17,
    0x18, 0x19, 0x1a, 0x1b, 0x1c, 0x1d, 0x1e, 0x1f, 0x20, 0x21, 0x22, 0x23,
    0x24, 0x25, 0x26, 0x27, 0x28, 0x29, 0x2a, 0x2b, 0x2c, 0x2d, 0x2e, 0x2f,
    0x30, 0x31, 0x32, 0x33, 0x34, 0x35, 0x36, 0x37, 0x38, 0x39, 0x3a, 0x3b,
    0x3c, 0x3d, 0x3e, 0x3f, 0x40, 0x41, 0x42, 0x43, 0x44, 0x45, 0x46, 0x47,
    0x48, 0x49, 0x4a, 0x4b, 0x4c, 0x4d, 0x4e, 0x4f, 0x50, 0x51, 0x52, 0x53,
    0x54, 0x55, 0x56, 0x57, 0x58, 0x59, 0x5a, 0x5b, 0x5c, 0x5d, 0x5e, 0x5f,
    0x60, 0x61, 0x62, 0x63, 0x64, 0x65, 0x66, 0x67, 0x68, 0x69, 0x6a, 0x6b,
    0x6c, 0x6d, 0x6e, 0x6f, 0x70, 0x71, 0x72, 0x73, 0x74, 0x75, 0x76, 0x77,
    0x78, 0x79, 0x7a, 0x7b, 0x07, 0x69, 0x97, 0x00, 0x10, 0x00, 0x20, 0x00,
    0x9d, 0x7b, 0x41, 0x1c, 0xbe, 0x2f, 0x50, 0x1d, 0xb3, 0x27, 0x5c, 0x2d,
    0x0a, 0xfd, 0x1d, 0x8b, 0x71, 0xab, 0x10, 0x49, 0xbd, 0x27, 0x20, 0x36,
    0xd6, 0xd3, 0x1e, 0xcf, 0x51, 0x3a, 0x81, 0xb7, 0x01, 0x00, 0x20, 0x00,
    0x2f, 0x56, 0x6d, 0x57, 0xef, 0x14, 0xed, 0x76, 0xf8, 0xcd, 0xf6, 0x53,
    0x0e, 0xef, 0xd7, 0x82, 0x6b, 0x8a, 0xad, 0xfd, 0x33, 0x51, 0x11, 0x86,
    0xe6, 0x08, 0x2d, 0x36, 0x85, 0x25, 0x2b, 0x21, 0x22, 0x00, 0x47, 0x00,
    0x30, 0x45, 0x02, 0x21, 0x00, 0x8c, 0xd0, 0xad, 0xba, 0x0b, 0x45, 0xc1,
    0xc5, 0x0f, 0x77, 0xa4, 0x04, 0x7a, 0x3c, 0xfe, 0xe0, 0x91, 0x25, 0x09,
    0xc0, 0x8c, 0x66, 0x8d, 0x83, 0xeb, 0x8d, 0x7a, 0x21, 0xf3, 0xa6, 0x79,
    0x16, 0x02, 0x20, 0x20, 0x35, 0x6d, 0x96, 0x29, 0xdf, 0x0c, 0x9c, 0xe5,
    0x18, 0xb4, 0xf0, 0x30, 0x1f, 0x25, 0x28, 0x10, 0xec, 0x9e, 0xdc, 0x0b,
    0xf0, 0x67, 0x15, 0x7d, 0xa4, 0x43, 0x02, 0xf8, 0xbd, 0x1a, 0xe0
};
```
